## firmware/espnow_receiver/main/Kconfig.projbuild
```kconfig
menu "ESP-NOW Receiver Configuration"
    config ESPNOW_CHANNEL
        int "Channel"
        default 1
        range 0 14
        help
            The channel on which sending and receiving ESPNOW data.
endmenu
```
